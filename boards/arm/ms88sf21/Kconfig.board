## boards/arm/ms88sf21/Kconfig.board
```kconfig
menuconfig BOARD_MS88SF21
    bool "MS88SF21 nRF52840 keyboard board"
    depends on SOC_NRF52840_QIAA
```

## boards/arm/ms88sf21/Kconfig.defconfig
```kconfig
if BOARD_MS88SF21

config ZMK_KEYBOARD_NAME
    default "MS88SF21"

if USB

config USB_NRFX
    default y

config USB_DEVICE_STACK
    default y

endif # USB

config BT_CTLR
    default BT

endif # BOARD_MS88SF21
```
